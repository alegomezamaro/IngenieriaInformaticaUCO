## STR/Prácticas/STR2026_P1_2/src/Kconfig.projbuild
```kconfig
menu "Configuracion Practica 1.2"

    config MI_VARIABLE_BOOL
        bool "Activar saludo especial"
        default y
        help
            Activa o desactiva un mensaje extra en el terminal.

    config MI_VARIABLE_INT
        int "Numero de repeticiones"
        range 1 10
        default 3
        help
            Define cuántas veces se repetirá el mensaje.

    config MI_VARIABLE_STRING
        string "Nombre del usuario"
        default "Estudiante STR"
        help
            El nombre que aparecerá en el printf.

    config MI_VARIABLE_HEX
        hex "Codigo Hexadecimal (Ejemplo)"
        default 0xAABBCC
        help
            Variable para probar valores hexadecimales.

    choice TIPO_PLACA
        prompt "Selecciona la version de hardware"
        default PLACA_V1

        config PLACA_V1
            bool "Hardware Version 1.0"

        config PLACA_V2
            bool "Hardware Version 2.0"
    endchoice

endmenu
```

## STR/Prácticas/STR2026_P1_3/src/Kconfig.projbuild
```kconfig
menu "Configuración Práctica 1 parte 3"
    config GPIO_PIN
        int "GPIO Pin"
        range 1 39
        default 13
        help
            Número de puerto de entrada/salida de propósito general (GPIO) donde se conecta la señal del pulsador
endmenu
```

## STR/Prácticas/STR2026_P2/src/Kconfig.projbuild
```kconfig
menu "Configuración Práctica 2"

    config MATRIX_SIZE
        int "Tamaño de la matriz"
        default 10
        help
            Establece el tamaño (N x N) para las matrices en la prueba de rendimiento de multiplicación.
endmenu
```

## STR/STR Víctor/Practica1_i12cofem_i02roalj/STR2024_P1_2/src/Kconfig.projbuild
```kconfig
menu "Mi Menu de Configuración"

# Este bloque permite elegir entre a, b, o c si MI_OPCION_ABC está habilitado
config MI_OPCION_ABC
    tristate "Elige una opción (a, b, c)"
    default y
    help
        Elige entre las opciones a, b o c.

if MI_OPCION_ABC

choice
    prompt "Elige tu opción"
    default OPCION_A

config OPCION_A
    bool "Opción A"

config OPCION_B
    bool "Opción B"

config OPCION_C
    bool "Opción C"

endchoice

endif

# Submenu para opciones adicionales
menu "Submenu Ejemplo"
    config MI_SUBMENU_OPCION
        bool "Una opción en submenu"
        default y
        help
            Esta es una opción dentro de un submenu.

    config MI_SUBMENU_OPCION_NUMERICA
        int "Configura un valor numérico"
        default 5
        range 1 10
        help
            Configura un valor entre 1 y 10.
endmenu

endmenu
```

## STR/STR Víctor/Practica1_i12cofem_i02roalj/STR2024_P1_3/src/Kconfig.projbuild
```kconfig
menu "Configuración Práctica 1 parte 3"
 config GPIO_PIN
 int "GPIO Pin"
 range 1 39
 default 13
endmenu
```
